## apps/interpreters/Kconfig
```kconfig
#
# For a description of the syntax of this configuration file,
# see misc/tools/kconfig-language.txt.
#

source "$APPSDIR/interpreters/ficl/Kconfig"

config INTERPRETERS_PCODE
	bool "Pascal p-code interpreter"
	default n
	---help---
		Enable support for the Pascal p-code interpreter.  See README file at misc/pascal
		and also the README.txt file in the apps/interpreter directory. Use of this
		configuration implies that you have performed the required installation of the
		Pascal run-time code.

config INTERPRETERS_LUA
	bool "Lua Application"
	default y
	---help---
		Enable support for the Lua interpreter app. Required LuaLib enabled also

config INTERPRETERS_LUALIB
	bool "Lua Library"
	default y

if INTERPRETERS_PCODE
endif
```
